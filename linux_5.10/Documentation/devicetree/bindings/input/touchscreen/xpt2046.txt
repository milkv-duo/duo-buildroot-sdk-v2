## linux_5.10/Documentation/devicetree/bindings/input/touchscreen/xpt2046.txt
```
Device tree bindings for XPTEK's 2046
SPI driven touch screen controllers.

The node for this driver must be a child node of a SPI controller, hence
all mandatory properties described in

	Documentation/devicetree/bindings/spi/spi-bus.txt

must be specified.

Additional required properties:

	compatible		Must be one of the following, depending on the
				model:
					"xptek,xpt2046"


	interrupts		An interrupt node describing the IRQ line the chip's
				!PENIRQ pin is connected to.
	vcc-supply		A regulator node for the supply voltage.


Optional properties:

	xptek,vref-delay-usecs		vref supply delay in usecs, 0 for
					external vref (u16).
	xptek,vref-mv			The VREF voltage, in millivolts (u16).
					Set to 0 to use internal references
					(ADS7846).
	xptek,keep-vref-on			set to keep vref on for differential
					measurements as well
	xptek,settle-delay-usec		Settling time of the analog signals;
					a function of Vcc and the capacitance
					on the X/Y drivers.  If set to non-zero,
					two samples are taken with settle_delay
					us apart, and the second one is used.
					~150 uSec with 0.01uF caps (u16).
	xptek,penirq-recheck-delay-usecs	If set to non-zero, after samples are
					taken this delay is applied and penirq
					is rechecked, to help avoid false
					events.  This value is affected by the
					material used to build the touch layer
					(u16).
	xptek,x-plate-ohms			Resistance of the X-plate,
					in Ohms (u16).
	xptek,y-plate-ohms			Resistance of the Y-plate,
					in Ohms (u16).
	xptek,x-min			Minimum value on the X axis (u16).
	xptek,y-min			Minimum value on the Y axis (u16).
	xptek,debounce-tol			Tolerance used for filtering (u16).
	xptek,debounce-rep			Additional consecutive good readings
					required after the first two (u16).
	xptek,pendown-gpio-debounce	Platform specific debounce time for the
					pendown-gpio (u32).
	pendown-gpio			GPIO handle describing the pin the !PENIRQ
					line is connected to.
	wakeup-source			use any event on touchscreen as wakeup event.
					(Legacy property support: "linux,wakeup")
	touchscreen-size-x		General touchscreen binding, see [1].
	touchscreen-size-y		General touchscreen binding, see [1].
	touchscreen-max-pressure	General touchscreen binding, see [1].
	touchscreen-min-pressure	General touchscreen binding, see [1].
	touchscreen-average-samples	General touchscreen binding, see [1].
	touchscreen-inverted-x		General touchscreen binding, see [1].
	touchscreen-inverted-y		General touchscreen binding, see [1].
	touchscreen-swapped-x-y		General touchscreen binding, see [1].

[1] All general touchscreen properties are described in
    Documentation/devicetree/bindings/input/touchscreen/touchscreen.txt.

Deprecated properties:

	xptek,swap-xy			swap x and y axis
	xptek,x-max			Maximum value on the X axis (u16).
	xptek,y-max			Maximum value on the Y axis (u16).
	xptek,pressure-min			Minimum reported pressure value
					(threshold) - u16.
	xptek,pressure-max			Maximum reported pressure value (u16).
	xptek,debounce-max			Max number of additional readings per
					sample (u16).

Example for a XPT2046 chip connected to an McSPI controller of an OMAP SoC::

	spi_controller {
		xpt2046@0 {
			reg = <0>;	/* CS0 */
			compatible = "xptek,xpt2046";
			interrupt-parent = <&porta>;
			interrupts = <8 0>;	/* BOOT6 / GPIO 8 */
			spi-max-frequency = <1000000>;
			pendown-gpio = <&porta 8 0>;
			vcc-supply = <&reg_vcc3>;

			xptek,x-min = /bits/ 16 <0>;
			xptek,x-max = /bits/ 16 <8000>;
			xptek,y-min = /bits/ 16 <0>;
			xptek,y-max = /bits/ 16 <4800>;
			xptek,x-plate-ohms = /bits/ 16 <40>;
			xptek,pressure-max = /bits/ 16 <255>;

			wakeup-source;
		};
	};
```
