## buildroot-2024.02/configs/milkv-duos-glibc-arm64-sd_defconfig
```kconfig
BR2_aarch64=y
BR2_TOOLCHAIN_EXTERNAL=y
BR2_TOOLCHAIN_EXTERNAL_CUSTOM=y
BR2_TOOLCHAIN_EXTERNAL_PATH="$(TOPDIR)/../host-tools/gcc/gcc-linaro-7.3.1-2018.05-x86_64_aarch64-linux-gnu"
BR2_TOOLCHAIN_EXTERNAL_CUSTOM_PREFIX="aarch64-linux-gnu"
BR2_TOOLCHAIN_EXTERNAL_GCC_7=y
BR2_TOOLCHAIN_EXTERNAL_HEADERS_4_10=y
BR2_TOOLCHAIN_EXTERNAL_CUSTOM_GLIBC=y
BR2_TOOLCHAIN_EXTERNAL_CXX=y
BR2_TOOLCHAIN_EXTERNAL_FORTRAN=y
BR2_TOOLCHAIN_EXTERNAL_OPENMP=y
BR2_OPTIMIZE_S=y
BR2_TARGET_GENERIC_HOSTNAME="milkv-duo"
BR2_TARGET_GENERIC_ISSUE="Welcome to Milk-V DuoS ARM64 SD"
BR2_TARGET_GENERIC_ROOT_PASSWD="milkv"
BR2_ROOTFS_OVERLAY="board/milkv/milkv-duos-glibc-arm64-sd/overlay"
BR2_PACKAGE_BUSYBOX_SHOW_OTHERS=y
BR2_PACKAGE_ALSA_UTILS=y
BR2_PACKAGE_ALSA_UTILS_AMIXER=y
BR2_PACKAGE_ALSA_UTILS_APLAY=y
BR2_PACKAGE_ALSA_UTILS_ARECORDMIDI=y
BR2_PACKAGE_GZIP=y
BR2_PACKAGE_P7ZIP=y
BR2_PACKAGE_UNRAR=y
BR2_PACKAGE_UNZIP=y
BR2_PACKAGE_ZIP=y
BR2_PACKAGE_ZSTD=y
BR2_PACKAGE_FIO=y
BR2_PACKAGE_GDB=y
BR2_PACKAGE_GDB_SERVER=y
BR2_PACKAGE_GDB_DEBUGGER=y
BR2_PACKAGE_LSOF=y
BR2_PACKAGE_PV=y
BR2_PACKAGE_SPIDEV_TEST=y
BR2_PACKAGE_STRACE=y
BR2_PACKAGE_STRESS_NG=y
BR2_PACKAGE_TREE=y
BR2_PACKAGE_E2FSPROGS=y
BR2_PACKAGE_E2FSPROGS_RESIZE2FS=y
BR2_PACKAGE_EVTEST=y
BR2_PACKAGE_I2C_TOOLS=y
BR2_PACKAGE_PARTED=y
BR2_PACKAGE_SPI_TOOLS=y
BR2_PACKAGE_PYTHON3=y
BR2_PACKAGE_PYTHON3_PY_PYC=y
BR2_PACKAGE_PYTHON3_BZIP2=y
BR2_PACKAGE_PYTHON3_READLINE=y
BR2_PACKAGE_PYTHON3_SQLITE=y
BR2_PACKAGE_PYTHON3_XZ=y
BR2_PACKAGE_PYTHON_PIP=y
BR2_PACKAGE_PYTHON_REQUESTS=y
BR2_PACKAGE_CA_CERTIFICATES=y
BR2_PACKAGE_LIBOPENSSL_BIN=y
BR2_PACKAGE_LIBOPENSSL_ENGINES=y
BR2_PACKAGE_C_PERIPHERY=y
BR2_PACKAGE_LIBUSB=y
BR2_PACKAGE_LIBUSB_EXAMPLES=y
BR2_PACKAGE_JSON_C=y
BR2_PACKAGE_LIBCURL=y
BR2_PACKAGE_LIBCURL_CURL=y
BR2_PACKAGE_LIBCURL_VERBOSE=y
BR2_PACKAGE_LIBCURL_WEBSOCKETS_SUPPORT=y
BR2_PACKAGE_BLUEZ_TOOLS=y
BR2_PACKAGE_BLUEZ5_UTILS=y
BR2_PACKAGE_BLUEZ5_UTILS_OBEX=y
BR2_PACKAGE_BLUEZ5_UTILS_CLIENT=y
BR2_PACKAGE_BLUEZ5_UTILS_MONITOR=y
BR2_PACKAGE_BLUEZ5_UTILS_TOOLS=y
BR2_PACKAGE_BLUEZ5_UTILS_DEPRECATED=y
BR2_PACKAGE_BLUEZ5_UTILS_EXPERIMENTAL=y
BR2_PACKAGE_BLUEZ5_UTILS_PLUGINS_AUDIO=y
BR2_PACKAGE_BLUEZ5_UTILS_PLUGINS_HEALTH=y
BR2_PACKAGE_BLUEZ5_UTILS_PLUGINS_HID=y
BR2_PACKAGE_BLUEZ5_UTILS_PLUGINS_MIDI=y
BR2_PACKAGE_BLUEZ5_UTILS_PLUGINS_NFC=y
BR2_PACKAGE_DHCPCD=y
BR2_PACKAGE_DNSMASQ=y
BR2_PACKAGE_DROPBEAR=y
BR2_PACKAGE_ETHTOOL=y
BR2_PACKAGE_IPERF3=y
BR2_PACKAGE_IW=y
BR2_PACKAGE_NETCAT=y
BR2_PACKAGE_NTP=y
BR2_PACKAGE_NTP_NTPDATE=y
BR2_PACKAGE_NTP_NTPTIME=y
BR2_PACKAGE_WGET=y
BR2_PACKAGE_WPA_SUPPLICANT=y
BR2_PACKAGE_WPA_SUPPLICANT_WPS=y
BR2_PACKAGE_WPA_SUPPLICANT_WPA3=y
BR2_PACKAGE_WPA_SUPPLICANT_CLI=y
BR2_PACKAGE_WPA_SUPPLICANT_WPA_CLIENT_SO=y
BR2_PACKAGE_WPA_SUPPLICANT_PASSPHRASE=y
BR2_PACKAGE_FILE=y
BR2_PACKAGE_CVI_PINMUX=y
BR2_PACKAGE_CVI_PINMUX_SG200X=y
BR2_PACKAGE_DUO_PINMUX=y
BR2_PACKAGE_DUO_PINMUX_DUOS=y
BR2_PACKAGE_DUO_WIRINGX=y
BR2_PACKAGE_COREUTILS=y
BR2_PACKAGE_HTOP=y
BR2_PACKAGE_KMOD=y
BR2_PACKAGE_TAR=y
BR2_PACKAGE_UTIL_LINUX_BINARIES=y
BR2_PACKAGE_UTIL_LINUX_RFKILL=y
BR2_TARGET_ROOTFS_EXT2=y
BR2_TARGET_ROOTFS_EXT2_4=y
BR2_TARGET_ROOTFS_EXT2_SIZE="786432K"
BR2_TARGET_ROOTFS_TAR_XZ=y
BR2_PACKAGE_HOST_GENIMAGE=y
```

## buildroot-2024.02/package/sophgo-library/Config.in
```kconfig
config BR2_PACKAGE_SOPHGO_LIBRARY
	bool "sophgo library"
	depends on BR2_aarch64 || BR2_RISCV_64
	help
	  Some library files provided by Sophgo.
```

## buildroot/package/cvi-pinmux/Config.in
```kconfig
config BR2_PACKAGE_CVI_PINMUX
	bool "cvi-pinmux"
	help
	  CVI Pin Multiplexing.

if BR2_PACKAGE_CVI_PINMUX

choice
	prompt "cvi pin multiplexing"
	default BR2_PACKAGE_CVI_PINMUX_CV180X

config BR2_PACKAGE_CVI_PINMUX_CV180X
	bool "CV180X"
	help
	  pinmux for cv180x.

config BR2_PACKAGE_CVI_PINMUX_SG200X
	bool "SG200X"
	help
	  pinmux for sg200x.

endchoice

endif
```

## buildroot/package/duo-pinmux/Config.in
```kconfig
config BR2_PACKAGE_DUO_PINMUX
	bool "duo-pinmux"
	help
	  Milk-V Duo Pin Multiplexing.

if BR2_PACKAGE_DUO_PINMUX

choice
	prompt "duo pin multiplexing"
	default BR2_PACKAGE_DUO_PINMUX_DUO

config BR2_PACKAGE_DUO_PINMUX_DUO
	bool "Duo"
	help
	  pinmux for Duo.

config BR2_PACKAGE_DUO_PINMUX_DUO256M
	bool "Duo256M"
	help
	  pinmux for Duo256M.

config BR2_PACKAGE_DUO_PINMUX_DUOS
	bool "DuoS"
	help
	  pinmux for DuoS.

endchoice

endif
```

## buildroot/package/duo-wiringx/Config.in
```kconfig
config BR2_PACKAGE_DUO_WIRINGX
	bool "wiringX"
	help
	  wiringX for Milk-V Duo series

	  https://github.com/milkv-duo/duo-wiringx
```

## buildroot/package/sophgo-library/Config.in
```kconfig
config BR2_PACKAGE_SOPHGO_LIBRARY
	bool "sophgo library"
	depends on BR2_aarch64 || BR2_RISCV_64
	help
	  Some library files provided by Sophgo.

if BR2_PACKAGE_SOPHGO_LIBRARY

choice
	prompt "sophgo library select"
	default BR2_PACKAGE_SOPHGO_LIBRARY_SG200X

config BR2_PACKAGE_SOPHGO_LIBRARY_CV180X
	bool "CV180X"
	help
	  sophgo library for cv180x.

config BR2_PACKAGE_SOPHGO_LIBRARY_SG200X
	bool "SG200X"
	help
	  sophgo library for sg200x.

endchoice

endif
```

## linux_5.10/drivers/net/wireless/bouffalolab/Kconfig
```kconfig
# SPDX-License-Identifier: GPL-2.0-only
config WLAN_VENDOR_BOUFFALOLAB
	bool "Bouffalolab devices"
	default n
	help
	  If you have a wireless card belonging to this class, say Y.

	  Note that the answer to this question doesn't directly affect the
	  kernel: saying N will just cause the configurator to skip all the
	  questions about these cards. If you say Y, you will be asked for
	  your specific card in the following questions.

if WLAN_VENDOR_BOUFFALOLAB

config BL602C
    tristate "Bouffalolab BL602C SDIO WiFi"
    help
      This chip work through SDIO.
      You need to say Y if your board use this chip to implement wifi

endif # WLAN_VENDOR_BOUFFALOLAB
```

## osdrv/extdrv/wireless/bouffalolab/bl602c/Kconfig
```kconfig
config BL602C
	tristate "bouffalolab BL602C sdio WiFi"
	default m
	---help---
	  Help message of BL602C
```

## ramdisk/rootfs/public/cvitracer/Kconfig
```kconfig
config TARGET_PACKAGE_CVITRACER
	bool "Target package cvitracer"
	default n
	help
	  target cvitracer
```
