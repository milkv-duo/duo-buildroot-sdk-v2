/dts-v1/;
#include "cv181x_base_arm.dtsi"
#include "cv181x_asic_bga.dtsi"
#include "cv181x_asic_sd.dtsi"
#include "cv181x_default_memmap.dtsi"

/ {
	model = "Milk-V DuoS";

	sd:cv-sd@4310000 {
		max-frequency = <10000000>;
	};
};

&dac {
	/delete-property/ mute-gpio-l;
	/delete-property/ mute-gpio-r;
};

/* mipi dsi for kernel */
&mipi_tx {
	compatible = "cvitek,mipi_tx";
	reset-gpio = <&porte 2 GPIO_ACTIVE_LOW>;
	pwm-gpio = <&porte 0 GPIO_ACTIVE_HIGH>;
	power-ct-gpio = <&porte 1 GPIO_ACTIVE_HIGH>;
	status = "okay";
};
