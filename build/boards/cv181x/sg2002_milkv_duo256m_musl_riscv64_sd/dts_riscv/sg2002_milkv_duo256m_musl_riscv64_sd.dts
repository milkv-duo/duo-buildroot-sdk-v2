/dts-v1/;
#include "cv181x_base_riscv.dtsi"
#include "cv181x_asic_qfn.dtsi"
#include "cv181x_asic_sd.dtsi"
#include "cv181x_default_memmap.dtsi"

/ {
	model = "Milk-V Duo256M";
};

&dac {
	mute-gpio-r = <&porte 1 GPIO_ACTIVE_LOW>;
};

